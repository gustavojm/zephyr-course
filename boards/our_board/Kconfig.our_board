## boards/our_board/Kconfig.our_board
```kconfig
# STM32H755ZI Nucleo board configuration

# Copyright (c) 2024 S&C Electric Company <Michael.Banducci@sandc.com>
# SPDX-License-Identifier: Apache-2.0

config BOARD_OUR_BOARD
    select SOC_STM32H755XX_M7
```

## boards/our_board/board.yml
```yaml
board:
  name: our_board
  full_name: Nucleo H755ZI-Q our_board
  vendor: st
  socs:
    - name: stm32h755xx
```

## boards/our_picow_board/Kconfig.defconfig
```kconfig
# Copyright (c) 2021 Yonatan Schachter
# SPDX-License-Identifier: Apache-2.0

config BOARD_OUR_PICOW_BOARD
	select RP2_FLASH_W25Q080

CONFIG_SERIAL=y
CONFIG_CONSOLE=y
CONFIG_UART_CONSOLE=y
CONFIG_GPIO=y
CONFIG_USE_DT_CODE_PARTITION=y
CONFIG_BUILD_OUTPUT_UF2=y
CONFIG_BUILD_OUTPUT_HEX=y
CONFIG_UART_INTERRUPT_DRIVEN=y
CONFIG_RESET=y
CONFIG_CLOCK_CONTROL=y
```

## boards/our_picow_board/board.yml
```yaml
board:
  name: our_picow_board
  full_name: Our board from scratch based on Raspberry Pi Pico
  vendor: ourself
  socs:
    - name: rp2040
```

## modules_usage/drivers/our_driver/Kconfig
```kconfig
config OUR_DRIVER
bool "Our custom driver"
default y
depends on DT_HAS_OUR_DRIVER_ENABLED
```

## twister-out.11/native_sim_native/host/zephyr/zephyr-course/tests/ring_buf/homework.unit.ring_buf/Kconfig/soc/Kconfig
```kconfig
# Load Zephyr SoC Kconfig descriptions.
osource "/home/gustavo/zephyrproject/zephyr/soc/xlnx/zynqmp/Kconfig"
osource "/home/gustavo/zephyrproject/zephyr/soc/xlnx/zynq7000/Kconfig"
osource "/home/gustavo/zephyrproject/zephyr/soc/xlnx/versalnet/Kconfig"
osource "/home/gustavo/zephyrproject/zephyr/soc/xlnx/versal2/Kconfig"
osource "/home/gustavo/zephyrproject/zephyr/soc/xen/Kconfig"
osource "/home/gustavo/zephyrproject/zephyr/soc/wch/ch32v/Kconfig"
osource "/home/gustavo/zephyrproject/zephyr/soc/ti/simplelink/Kconfig"
osource "/home/gustavo/zephyrproject/zephyr/soc/ti/mspm0/Kconfig"
osource "/home/gustavo/zephyrproject/zephyr/soc/ti/lm3s6965/Kconfig"
osource "/home/gustavo/zephyrproject/zephyr/soc/ti/k3/Kconfig"
osource "/home/gustavo/zephyrproject/zephyr/soc/telink/tlsr/Kconfig"
osource "/home/gustavo/zephyrproject/zephyr/soc/starfive/jh71xx/Kconfig"
osource "/home/gustavo/zephyrproject/zephyr/soc/st/stm32/Kconfig"
osource "/home/gustavo/zephyrproject/zephyr/soc/snps/qemu_arc/Kconfig"
osource "/home/gustavo/zephyrproject/zephyr/soc/snps/nsim/arc_v/Kconfig"
osource "/home/gustavo/zephyrproject/zephyr/soc/snps/nsim/arc_classic/Kconfig"
osource "/home/gustavo/zephyrproject/zephyr/soc/snps/hsdk4xd/Kconfig"
osource "/home/gustavo/zephyrproject/zephyr/soc/snps/hsdk/Kconfig"
osource "/home/gustavo/zephyrproject/zephyr/soc/snps/emsk/Kconfig"
osource "/home/gustavo/zephyrproject/zephyr/soc/snps/emsdp/Kconfig"
osource "/home/gustavo/zephyrproject/zephyr/soc/snps/arc_iot/Kconfig"
osource "/home/gustavo/zephyrproject/zephyr/soc/silabs/Kconfig"
osource "/home/gustavo/zephyrproject/zephyr/soc/sifli/sf32/Kconfig"
osource "/home/gustavo/zephyrproject/zephyr/soc/sifive/sifive_freedom/Kconfig"
osource "/home/gustavo/zephyrproject/zephyr/soc/sensry/Kconfig"
osource "/home/gustavo/zephyrproject/zephyr/soc/rockchip/Kconfig"
osource "/home/gustavo/zephyrproject/zephyr/soc/renode/riscv_virtual/Kconfig"
osource "/home/gustavo/zephyrproject/zephyr/soc/renode/cortex_r8_virtual/Kconfig"
osource "/home/gustavo/zephyrproject/zephyr/soc/renesas/smartbond/Kconfig"
osource "/home/gustavo/zephyrproject/zephyr/soc/renesas/rz/Kconfig"
osource "/home/gustavo/zephyrproject/zephyr/soc/renesas/rx/Kconfig"
osource "/home/gustavo/zephyrproject/zephyr/soc/renesas/rcar/Kconfig"
osource "/home/gustavo/zephyrproject/zephyr/soc/renesas/ra/Kconfig"
osource "/home/gustavo/zephyrproject/zephyr/soc/realtek/ec/Kconfig"
osource "/home/gustavo/zephyrproject/zephyr/soc/raspberrypi/rpi_pico/Kconfig"
osource "/home/gustavo/zephyrproject/zephyr/soc/quicklogic/eos_s3/Kconfig"
osource "/home/gustavo/zephyrproject/zephyr/soc/qemu/virt_riscv/Kconfig"
osource "/home/gustavo/zephyrproject/zephyr/soc/qemu/malta/Kconfig"
osource "/home/gustavo/zephyrproject/zephyr/soc/openisa/rv32m1/Kconfig"
osource "/home/gustavo/zephyrproject/zephyr/soc/openhwgroup/cva6/Kconfig"
osource "/home/gustavo/zephyrproject/zephyr/soc/oct/osd32mp15x/Kconfig"
osource "/home/gustavo/zephyrproject/zephyr/soc/nxp/s32/Kconfig"
osource "/home/gustavo/zephyrproject/zephyr/soc/nxp/rw/Kconfig"
osource "/home/gustavo/zephyrproject/zephyr/soc/nxp/mcx/Kconfig"
osource "/home/gustavo/zephyrproject/zephyr/soc/nxp/lpc/Kconfig"
osource "/home/gustavo/zephyrproject/zephyr/soc/nxp/layerscape/Kconfig"
osource "/home/gustavo/zephyrproject/zephyr/soc/nxp/kinetis/Kconfig"
osource "/home/gustavo/zephyrproject/zephyr/soc/nxp/imxrt/Kconfig"
osource "/home/gustavo/zephyrproject/zephyr/soc/nxp/imx/Kconfig"
osource "/home/gustavo/zephyrproject/zephyr/soc/nuvoton/numicro/Kconfig"
osource "/home/gustavo/zephyrproject/zephyr/soc/nuvoton/numaker/Kconfig"
osource "/home/gustavo/zephyrproject/zephyr/soc/nuvoton/npcx/Kconfig"
osource "/home/gustavo/zephyrproject/zephyr/soc/nuvoton/npcm/Kconfig"
osource "/home/gustavo/zephyrproject/zephyr/soc/nordic/Kconfig"
osource "/home/gustavo/zephyrproject/zephyr/soc/neorv32/Kconfig"
osource "/home/gustavo/zephyrproject/zephyr/soc/native/inf_clock/Kconfig"
osource "/home/gustavo/zephyrproject/zephyr/soc/microchip/sam/Kconfig"
osource "/home/gustavo/zephyrproject/zephyr/soc/microchip/sam/sama7/Kconfig"
osource "/home/gustavo/zephyrproject/zephyr/soc/microchip/sam/sam_d5x_e5x/Kconfig"
osource "/home/gustavo/zephyrproject/zephyr/soc/microchip/pic32c/pic32cz_ca/Kconfig"
osource "/home/gustavo/zephyrproject/zephyr/soc/microchip/pic32c/pic32cx_sg/Kconfig"
osource "/home/gustavo/zephyrproject/zephyr/soc/microchip/pic32c/pic32cm_jh/Kconfig"
osource "/home/gustavo/zephyrproject/zephyr/soc/microchip/miv/Kconfig"
osource "/home/gustavo/zephyrproject/zephyr/soc/microchip/mec/Kconfig"
osource "/home/gustavo/zephyrproject/zephyr/soc/mediatek/mt8xxx/Kconfig"
osource "/home/gustavo/zephyrproject/zephyr/soc/lowrisc/opentitan/Kconfig"
osource "/home/gustavo/zephyrproject/zephyr/soc/litex/litex_vexriscv/Kconfig"
osource "/home/gustavo/zephyrproject/zephyr/soc/ite/ec/Kconfig"
osource "/home/gustavo/zephyrproject/zephyr/soc/intel/raptor_lake/Kconfig"
osource "/home/gustavo/zephyrproject/zephyr/soc/intel/panther_lake/Kconfig"
osource "/home/gustavo/zephyrproject/zephyr/soc/intel/lakemont/Kconfig"
osource "/home/gustavo/zephyrproject/zephyr/soc/intel/intel_socfpga_std/Kconfig"
osource "/home/gustavo/zephyrproject/zephyr/soc/intel/intel_socfpga/Kconfig"
osource "/home/gustavo/zephyrproject/zephyr/soc/intel/intel_niosv/Kconfig"
osource "/home/gustavo/zephyrproject/zephyr/soc/intel/intel_ish/Kconfig"
osource "/home/gustavo/zephyrproject/zephyr/soc/intel/intel_adsp/Kconfig"
osource "/home/gustavo/zephyrproject/zephyr/soc/intel/elkhart_lake/Kconfig"
osource "/home/gustavo/zephyrproject/zephyr/soc/intel/atom/Kconfig"
osource "/home/gustavo/zephyrproject/zephyr/soc/intel/apollo_lake/Kconfig"
osource "/home/gustavo/zephyrproject/zephyr/soc/intel/alder_lake/Kconfig"
osource "/home/gustavo/zephyrproject/zephyr/soc/infineon/edge/Kconfig"
osource "/home/gustavo/zephyrproject/zephyr/soc/infineon/cat3/Kconfig"
osource "/home/gustavo/zephyrproject/zephyr/soc/infineon/cat1c/Kconfig"
osource "/home/gustavo/zephyrproject/zephyr/soc/infineon/cat1b/Kconfig"
osource "/home/gustavo/zephyrproject/zephyr/soc/infineon/cat1a/Kconfig"
osource "/home/gustavo/zephyrproject/zephyr/soc/gd/gd32/Kconfig"
osource "/home/gustavo/zephyrproject/zephyr/soc/gaisler/leon3/Kconfig"
osource "/home/gustavo/zephyrproject/zephyr/soc/gaisler/gr716a/Kconfig"
osource "/home/gustavo/zephyrproject/zephyr/soc/espressif/Kconfig"
osource "/home/gustavo/zephyrproject/zephyr/soc/ene/kb1200/Kconfig"
osource "/home/gustavo/zephyrproject/zephyr/soc/ene/kb106x/Kconfig"
osource "/home/gustavo/zephyrproject/zephyr/soc/egis/Kconfig"
osource "/home/gustavo/zephyrproject/zephyr/soc/efinix/sapphire/Kconfig"
osource "/home/gustavo/zephyrproject/zephyr/soc/cdns/xtensa_sample_controller/Kconfig"
osource "/home/gustavo/zephyrproject/zephyr/soc/cdns/sample_controller32/Kconfig"
osource "/home/gustavo/zephyrproject/zephyr/soc/cdns/dc233c/Kconfig"
osource "/home/gustavo/zephyrproject/zephyr/soc/brcm/bcmvk/Kconfig"
osource "/home/gustavo/zephyrproject/zephyr/soc/brcm/bcm2712/Kconfig"
osource "/home/gustavo/zephyrproject/zephyr/soc/brcm/bcm2711/Kconfig"
osource "/home/gustavo/zephyrproject/zephyr/soc/bflb/Kconfig"
osource "/home/gustavo/zephyrproject/zephyr/soc/atmel/sam0/Kconfig"
osource "/home/gustavo/zephyrproject/zephyr/soc/atmel/sam/Kconfig"
osource "/home/gustavo/zephyrproject/zephyr/soc/aspeed/Kconfig"
osource "/home/gustavo/zephyrproject/zephyr/soc/arm/Kconfig"
osource "/home/gustavo/zephyrproject/zephyr/soc/arm/beetle/Kconfig"
osource "/home/gustavo/zephyrproject/zephyr/soc/antmicro/myra/Kconfig"
osource "/home/gustavo/zephyrproject/zephyr/soc/andestech/Kconfig"
osource "/home/gustavo/zephyrproject/zephyr/soc/amd/acp_6_0/Kconfig"
osource "/home/gustavo/zephyrproject/zephyr/soc/ambiq/Kconfig"
osource "/home/gustavo/zephyrproject/zephyr/soc/aesc/Kconfig"
osource "/home/gustavo/zephyrproject/zephyr/soc/adi/max32/Kconfig"
```

## twister-out.2/native_sim_native/host/zephyr/zephyr-course/tests/ring_buf/homework.unit.ring_buf/Kconfig/boards/Kconfig.sysbuild
```kconfig
# Load Sysbuild board Kconfig descriptions.
osource "/home/gustavo/zephyrproject/zephyr/boards/native/native_sim/Kconfig.sysbuild"
```

## twister-out.3/native_sim_native/host/zephyr/zephyr-course/tests/ring_buf/homework.unit.ring_buf/Kconfig/boards/Kconfig.defconfig
```kconfig
# Load Zephyr board defconfig descriptions.
osource "/home/gustavo/zephyrproject/zephyr/boards/native/native_sim/Kconfig.defconfig"
```

## twister-out.4/native_sim_native/host/zephyr/zephyr-course/tests/ring_buf/homework.unit.ring_buf/Kconfig/arch/Kconfig
```kconfig
# Load Zephyr Arch Kconfig descriptions.
osource "/home/gustavo/zephyrproject/zephyr/arch/rx/Kconfig"
osource "/home/gustavo/zephyrproject/zephyr/arch/x86/Kconfig"
osource "/home/gustavo/zephyrproject/zephyr/arch/xtensa/Kconfig"
osource "/home/gustavo/zephyrproject/zephyr/arch/sparc/Kconfig"
osource "/home/gustavo/zephyrproject/zephyr/arch/riscv/Kconfig"
osource "/home/gustavo/zephyrproject/zephyr/arch/posix/Kconfig"
osource "/home/gustavo/zephyrproject/zephyr/arch/mips/Kconfig"
osource "/home/gustavo/zephyrproject/zephyr/arch/arm64/Kconfig"
osource "/home/gustavo/zephyrproject/zephyr/arch/arm/Kconfig"
osource "/home/gustavo/zephyrproject/zephyr/arch/arc/Kconfig"
```

## twister-out.5/native_sim_native/host/zephyr/zephyr-course/tests/ring_buf/homework.unit.ring_buf/Kconfig/boards/Kconfig.native_sim
```kconfig
# Load board Kconfig descriptions.
osource "/home/gustavo/zephyrproject/zephyr/boards/native/native_sim/Kconfig.native_sim"
```

## twister-out.8/native_sim_native/host/zephyr/zephyr-course/tests/ring_buf/homework.unit.ring_buf/Kconfig/boards/Kconfig
```kconfig
# Load Zephyr board Kconfig descriptions.
osource "/home/gustavo/zephyrproject/zephyr/boards/native/native_sim/Kconfig"
```

## west.yml
```yaml
manifest:
  version: 1.0
  self:
    path: app

  projects:
    - name: zephyr
      url: https://github.com/zephyrproject-rtos/zephyr
      revision: v4.2.0
      import:
        name-allowlist:
          - cmsis_6
          # - hal_nxp
          - hal_stm32
          # - hal_nordicç
          - hal_rpi_pico
#        path-prefix: deps
```
