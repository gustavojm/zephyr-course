## CMakeLists.txt
```
cmake_minimum_required(VERSION 3.20.0)

cmake_path(GET CMAKE_CURRENT_LIST_DIR PARENT_PATH MODULES_USAGE_ROOT)

list(APPEND ZEPHYR_EXTRA_MODULES
    ${MODULES_USAGE_ROOT}
)

find_package(Zephyr REQUIRED)
project(my_zephyr_app)

target_sources(app PRIVATE src/main.cpp)
```

## Kconfig
```
menuconfig LED_SUBSYSTEM
    bool "LED Subsystem"
    default y
    help
      Enable or disable the LED subsystem settings.

if LED_SUBSYSTEM

choice
    prompt "LED blink sleep time"
    default BLINK_SLEEP_500MS

config BLINK_SLEEP_1000MS
    bool "Slow (1s)"

config BLINK_SLEEP_500MS
    bool "Medium (0.5s)"

config BLINK_SLEEP_250MS
    bool "High (0.25s)"

endchoice

config BLINK_SLEEP_TIME_MS
    int                 # Hidden value
    default 1000 if BLINK_SLEEP_1000MS
    default 500 if BLINK_SLEEP_500MS
    default 250 if BLINK_SLEEP_250MS
    default 0
    help
      The integer value selected by the choice above.


menuconfig LED_ADVANCED_SETTINGS
    bool "Advanced LED Settings"
    default n

if LED_ADVANCED_SETTINGS

    config LED_BRIGHTNESS
        int "LED Brightness"
        range 0 100
        default 50
        help
          Set the brightness level of the LEDs (0 for off, 100 for full brightness).
    
    config LED_FADE_DURATION_MS
        int "LED Fade Duration (ms)"
        range 0 5000
        default 1000
        help
          Set the duration for LED fade effects in milliseconds.

    menu "Expert settings"

        config LED_DEBUGGING
            bool "Enable LED debugging"

        config LED_BLINK_PATTERN
            string "Custom Blink Pattern"
            default "1010"
            help
              Define a custom blink pattern using a string of 1s and 0s, where '1' represents the LED being on and '0' represents it being off. For example, "1010" would create a pattern of on-off-on-off.
    endmenu

endif   #LED_ADVANCED_SETTINGS
endif   #LED_SUBSYSTEM

menu "Zephyr Settings"
    source "Kconfig.zephyr"
endmenu
```

## prj.conf
```kconfig
CONFIG_GPIO=y
CONFIG_LOG=y
CONFIG_APPLICATION_DEFINED_SYSCALL=y
```

## app.overlay
```dts
/ {
    our_driver0: our_driver0 {
        compatible = "our,driver";
        led-gpios = < &gpiob 0 GPIO_ACTIVE_HIGH >;      // green
        status = "okay";
    };

    our_driver1: our_driver1 {        
        compatible = "our,driver";
        led-gpios = < &gpioe 1 GPIO_ACTIVE_HIGH >;      // yellow
        status = "okay";
    };
};
```

## dts/bindings/our,driver.yaml
```yaml
description: Our simple GPIO driver
compatible: "our,driver"

include: base.yaml  # for status property

properties:
  led-gpios:
    type: phandle-array    
    description: |
      gpio info for the led handled by the driver.
```

## src/main.cpp
```c
// #include "syscalls/sensor.h"
// #include "zephyr/drivers/sensor.h"
#include <zephyr/device.h>
#include <zephyr/drivers/gpio.h>
#include <zephyr/kernel.h>
#include <zephyr/logging/log.h>

#include <app/drivers/our_driver.h>

/* The devicetree node identifier for the "led0" alias. */
// #define LED_NODE DT_ALIAS(status_led)

// static const struct gpio_dt_spec led = GPIO_DT_SPEC_GET(LED_NODE, gpios);

static const struct device *our_driver0 =
    DEVICE_DT_GET(DT_NODELABEL(our_driver0));
static const struct device *our_driver1 =
    DEVICE_DT_GET(DT_NODELABEL(our_driver1));

LOG_MODULE_REGISTER(main, LOG_LEVEL_INF);

int main(void) {
    
  if (!device_is_ready(our_driver0)) {
    return 0;
  }

  auto time_ms = 0;
  while (1) {
    time_ms += 100;
    our_driver_set_blink_time_ms(our_driver0, time_ms);
    
    int ret = our_driver_get_blink_time_ms(our_driver0);

    k_msleep(ret);
  
  }
  return 0;
}
```
